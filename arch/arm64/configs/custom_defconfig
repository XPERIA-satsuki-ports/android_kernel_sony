## arch/arm64/configs/custom_defconfig
```kconfig
CONFIG_NTFS_FS=y
# CONFIG_NTFS_DEBUG is not set
CONFIG_NTFS_RW=y

CONFIG_ARCH_THREAD_INFO_ALLOCATOR=y

CONFIG_ARCH_SUPPORTS_MSI=y

CONFIG_EXFAT_FS=y
CONFIG_EXFAT_DISCARD=y
CONFIG_EXFAT_DEFAULT_CODEPAGE=852

# CONFIG_MMC_DEBUG is not set
CONFIG_MMC_BLOCK_BOUNCE=y

CONFIG_PM_WAKELOCKS_GC=y

### CPU Frequency Governors ###
CONFIG_CPU_FREQ_GOV_ELEMENTALX=y
CONFIG_CPU_FREQ_GOV_ZZMOOVE=y
CONFIG_CPU_FREQ_GOV_ONDEMAND=y
CONFIG_CPU_FREQ_GOV_CONSERVATIVE=y
CONFIG_CPU_FREQ_GOV_ALUCARD=y
CONFIG_CPU_FREQ_DEFAULT_GOV_ALUCARD=y

### CPU Hotplugging driver ###
CONFIG_ALUCARD_HOTPLUG=y
CONFIG_CPU_QUIET=n

### TCP Algorithms ###
CONFIG_TCP_CONG_ADVANCED=y
CONFIG_TCP_CONG_WESTWOOD=y

### TCP Algorithms ###
CONFIG_TCP_CONG_ADVANCED=y
CONFIG_TCP_CONG_WESTWOOD=y

### Kexec-hardboot ###
CONFIG_KEXEC=y
# CONFIG_ATAGS_PROC is not set
CONFIG_KEXEC_HARDBOOT=y
CONFIG_PROC_DEVICETREE=y

CONFIG_VT=y
```
